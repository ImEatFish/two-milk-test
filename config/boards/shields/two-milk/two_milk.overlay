/*
 * two_milk 盾牌的 .overlay 文件
 * 只定义盾牌特有的硬件（按键），外部电源由主板的dts文件负责。
 */

/ {
    chosen {
        zmk,kscan = &default_kscan;
    };

    default_kscan: kscan {
        compatible = "zmk,kscan-gpio-direct";
        label = "default_kscan";
        input-gpios
            = <&gpio0 2 (GPIO_ACTIVE_LOW | GPIO_PULL_UP)>
            , <&gpio1 15 (GPIO_ACTIVE_LOW | GPIO_PULL_UP)>
            ;
    };

    // 【重要】确保这里没有 ext_power 相关的任何定义！
};
